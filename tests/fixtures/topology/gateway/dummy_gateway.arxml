AUTOSAR XML (schema 4-3-1)
standard types defined: uint8
package /DummyVehicle
  5 x ecu instance:
    SensorEcu
      can communication connector SensorBodyCanConn
    ActuatorEcu
      can communication connector ActuatorChassisCanConn
    ClimateEcu
      lin slave ClimateLinSlave
      lin communication connector ClimateCabinLinConn: comm-controller=ClimateLinSlave
    TelematicsEcu
      ethernet communication connector TelematicsBackboneEthConn: network-endpoint=TelematicsBackboneEp
    GatewayEcu
      lin master GatewayLinMaster
      can communication connector GatewayBodyCanConn
      can communication connector GatewayChassisCanConn
      lin communication connector GatewayCabinLinConn: comm-controller=GatewayLinMaster
      ethernet communication connector GatewayBackboneEthConn: network-endpoint=GatewayBackboneEp
  can cluster BodyCAN
    can physical channel BodyCANChannel: comm-connectors=[SensorBodyCanConn, GatewayBodyCanConn]
      frame SensorFrame01: id 0x101, from SensorEcu, to GatewayEcu, frame-length=8, can-addressing-mode=STANDARD
        pdu SensorPdu01: length=8
          signal SensorSignal01: start 0, 8 bit, little-endian, system signal SensorValue, base-type=uint8
  can cluster ChassisCAN
    can physical channel ChassisCANChannel: comm-connectors=[GatewayChassisCanConn, ActuatorChassisCanConn]
      frame ActuatorFrame01: id 0x201, from GatewayEcu, to ActuatorEcu, frame-length=8, can-addressing-mode=STANDARD
        carries pdu SensorPdu01: packing-byte-order=little-endian, start-position=0
      frame ClimateStateCanFrame01: id 0x202, from GatewayEcu, to ActuatorEcu, frame-length=8, can-addressing-mode=STANDARD
        pdu ClimateStatePdu01: length=8
          signal ClimateStateSignal01: start 0, 8 bit, little-endian, base-type=uint8
  lin cluster CabinLIN
    lin physical channel CabinLINChannel: comm-connectors=[GatewayCabinLinConn, ClimateCabinLinConn]
      frame ClimateFrame01: id 0x10, frame-length=8
        pdu ClimatePdu01: length=8
          signal ClimateSignal01: start 0, 8 bit, little-endian, system signal ClimateSetpoint, base-type=uint8
      frame ClimateStateFrame01: id 0x11, frame-length=8
        carries pdu ClimateStatePdu01: packing-byte-order=little-endian, start-position=0
  ethernet cluster BackboneETH
    ethernet physical channel BackboneETHChannel
      network endpoint GatewayBackboneEp: network-endpoint-addresses=ipv-4-configuration=ipv-4-address=10.0.0.1
      network endpoint TelematicsBackboneEp: network-endpoint-addresses=ipv-4-configuration=ipv-4-address=10.0.0.2
      so-ad-config:
        socket address GatewayBackboneSocket: connector=GatewayBackboneEthConn
          application endpoint GatewayBackboneAppEp: network-endpoint=GatewayBackboneEp, tp-configuration=udp-tp=udp-tp-port=port-number=50000
          static socket connection GatewayToTelematics: i-pdu-identifiers=[SoConStatusPdu01, SoConCommandPdu01], remote-addresss=TelematicsBackboneSocket
        socket address TelematicsBackboneSocket: connector=TelematicsBackboneEthConn
          application endpoint TelematicsBackboneAppEp: network-endpoint=TelematicsBackboneEp, tp-configuration=udp-tp=udp-tp-port=port-number=50001
  socket connection ipdu identifier set BackboneIpduIdentifiers
    so con i pdu identifier SoConStatusPdu01: header-id=1001, pdu-triggering=PtBackboneStatusPdu01
    so con i pdu identifier SoConCommandPdu01: header-id=1002, pdu-triggering=PtBackboneCommandPdu01
  gateway GatewayEcuRouting: ecu=GatewayEcu
    i pdu mapping SensorToActuatorRoute: source-i-pdu=PtSensorPdu01, target-i-pdu=PtActuatorPdu01
    i pdu mapping SensorToBackboneRoute: source-i-pdu=PtSensorPdu01, target-i-pdu=PtBackboneStatusPdu01
    i pdu mapping BackboneToClimateRoute: source-i-pdu=PtBackboneCommandPdu01, target-i-pdu=PtClimatePdu01
    i pdu mapping ClimateStateToChassisRoute: source-i-pdu=PtClimateStatePdu01, target-i-pdu=PtClimateStateCanPdu01
